## modules/hal_rpi_pico/Kconfig
```kconfig
# Copyright (c) 2021 Yonatan Schachter
# SPDX-License-Identifier: Apache-2.0

config HAS_RPI_PICO
	bool

config PICOSDK_USE_UART
	bool
	help
	  Use the UART driver from pico-sdk

config PICOSDK_USE_GPIO
	bool
	help
	  Use the GPIO driver from pico-sdk

config PICOSDK_USE_FLASH
	bool
	help
	  Use the flash driver from pico-sdk

config PICOSDK_USE_PWM
	bool
	help
	  Use the PWM driver from pico-sdk

config PICOSDK_USE_ADC
	bool
	help
	  Use the ADC driver from pico-sdk

config PICOSDK_USE_DMA
	bool
	help
	  Use the DMA driver from pico-sdk

config PICOSDK_USE_PIO
	bool
	select PICOSDK_USE_CLAIM
	help
	  Use the PIO driver from pico-sdk

config PICOSDK_USE_CLAIM
	bool
	help
	  Use the "claim" driver from pico-sdk

config PICOSDK_USE_TIMER
	bool
	help
	  Use the TIMER driver from pico-sdk

config PICOSDK_USE_RTC
	bool
	help
	  Use the RTC driver from pico-sdk

config PICOSDK_USE_SHA256
	bool
	help
	  Use the SHA-256 driver and utilities from pico-sdk

config PICOSDK_USE_RAND
	bool
	help
	  Use the "rand" driver from pico-sdk

config PICOSDK_USE_DCP_COPROC
	bool "Enable DCP coprocessor of M33 core and maintain the state in kernel"
	depends on ARM
	select ARM_SOC_CONTEXT_SAVE
	help
	  Enable DCP coprocessor of M33 core and maintain the state in kernel.
	  Enable this will save and restore the context across context switch,
	  syscall and ISR.

config PICOSDK_USE_SINGLE_FP
	bool "Enable optimized single precision floating point routines for RPxxxx."
	help
	  Use optimized single precision floating point routines for RPxxxx.

choice PICOSDK_USE_SINGLE_FP_IMPL
	prompt "Single precision floating point implementation"
	depends on PICOSDK_USE_SINGLE_FP
	default PICOSDK_USE_SINGLE_FP_IMPL_ROM if SOC_SERIES_RP2040
	default PICOSDK_USE_SINGLE_FP_IMPL_VFP if SOC_SERIES_RP2350 && !RISCV
	help
	  Choose the active implementation of single precision FP routines.

config PICOSDK_USE_SINGLE_FP_IMPL_TRAP
	bool "Disable all single precision floating point functions."
	help
	  Any use of FP math will panic. Included for debugging only.

config PICOSDK_USE_SINGLE_FP_IMPL_ROM
	bool "Wrap all single precision floating point functions with the ROM one."
	depends on !LINKER_SORT_BY_ALIGNMENT
	depends on SOC_SERIES_RP2040
	select NEED_LIBC_MEM_PARTITION
	select RP2_USE_SIO_DIVIDER
	select RP2_USERSPACE_DIVIDER if USERSPACE
	select RPI_PICO_USE_ROMFUNC
	help
	  * The ROM floating point routines contains unsafe use of SIO divider so
	  we enable RP2_USE_SIO_DIVIDER here.

	  * LINKER_SORT_BY_ALIGNMENT is incompatible with pico-sdk's soft fp
	  routines, which rely on precise placement of various functions. Such
	  unexpected sorting will break some branch instructions.

	  * See the datasheet for limitations and availability of ROM functions.
	  Different chip revisions may have different feature set.

config PICOSDK_USE_SINGLE_FP_IMPL_VFP
	bool "Use standard ARM VFP for single precision arithmetics"
	depends on SOC_SERIES_RP2350
	depends on !RISCV
	depends on FPU
	depends on FP_SOFTABI
	help
	  Use VFP FPU to accelerate all single precision arithmetics. Currently,
	  float point routines in pico-sdk only support softfp ABI. (pico-sdk#2785)

endchoice

config PICOSDK_SINGLE_FP_IN_RAM
	bool "Put basic single precision floating point functions into SRAM."
	default n
	depends on PICOSDK_USE_SINGLE_FP
	help
	  Put basic single precision floating point functions into SRAM.

config PICOSDK_SINGLE_FP_PROPAGATE_NANS
	bool "Propagate NANs for soft fp routines."
	default y
	depends on PICOSDK_USE_SINGLE_FP
	depends on !PICOSDK_SINGLE_FP_IN_RAM
	help
	  Propagate NANs for soft fp routines. Disable for PICOSDK_SINGLE_FP_IN_RAM
	  due to pico-sdk issue #2771.

config PICOSDK_USE_SINGLE_FP_IMPL_ROM_V1
	bool "Support for RP2040 ROM V1"
	default y
	depends on PICOSDK_USE_SINGLE_FP_IMPL_ROM
	help
	  Support for RP2040 ROM V1. See the datasheet for the differences between V1
	  and later revisions.

config PICOSDK_USE_DOUBLE_FP
	bool "Enable optimized double precision floating point routines for RPxxxx."
	depends on !RISCV
	help
	  Use the optimized double precision floating point routines for RPxxxx.
	  There are no optimized implementation for Hazard3 yet.

choice PICOSDK_USE_DOUBLE_FP_IMPL
	prompt "Double precision float point implementation"
	depends on PICOSDK_USE_DOUBLE_FP
	default PICOSDK_USE_DOUBLE_FP_IMPL_ROM if SOC_SERIES_RP2040
	help
	  Choose the active implementation of double precision floating point routines.

config PICOSDK_USE_DOUBLE_FP_IMPL_TRAP
	bool "Disable all double precision FP functions."
	help
	  Any use of double precision floating point math will panic. Intend for
	  debugging only.

config PICOSDK_USE_DOUBLE_FP_IMPL_ROM
	bool "Wrap all double FP with the ROM one."
	depends on !LINKER_SORT_BY_ALIGNMENT
	depends on SOC_SERIES_RP2040
	select PICOSDK_USE_HW_DIVIDER
	select NEED_LIBC_MEM_PARTITION
	select RPI_PICO_USE_ROMFUNC
	help
	  * The ROM FP routines has unsafe use of SIO divider so we enable
	  RP2_USE_SIO_DIVIDER here.

	  * LINKER_SORT_BY_ALIGNMENT is incompatible with pico-sdk's soft fp
	  routines, which rely on precise placement of various functions. Such
	  unexpected sorting will break some branch instructions.

	  * See the datasheet for limitations and availability of ROM functions.
	  Different chip revisions may have different feature set.

endchoice

config PICOSDK_DOUBLE_FP_IN_RAM
	bool "Put basic double precision FP functions into SRAM."
	default n
	depends on PICOSDK_USE_DOUBLE_FP
	help
	  Put basic double precision floating point functions into SRAM.

config PICOSDK_DOUBLE_FP_PROPAGATE_NANS
	bool "Propagate NANs for soft fp routines."
	default y
	depends on PICOSDK_USE_DOUBLE_FP
	depends on !PICOSDK_DOUBLE_FP_IN_RAM
	help
	  Propagate NANs for soft fp routines. Disable for PICOSDK_SINGLE_FP_IN_RAM
	  due to pico-sdk issue #2771.

config PICOSDK_USE_DOUBLE_FP_IMPL_ROM_V1
	bool "Support for RP2040 ROM V1"
	default y
	depends on PICOSDK_USE_DOUBLE_FP_IMPL_ROM
	help
	  Support for RP2040 ROM V1. See the datasheet for the differences between V1
	  and later revisions.

config PICOSDK_USE_HW_DIVIDER
	bool "Use RP2040's hardware divider."
	depends on SOC_SERIES_RP2040
	select RP2_USE_SIO_DIVIDER
	select RP2_USERSPACE_DIVIDER if USERSPACE
	help
	  Use RP2040's hardware divider in SIO block.

config PICOSDK_DIVIDER_IN_RAM
	bool "Put RP2040's divider functions into SRAM"
	default n
	depends on PICOSDK_USE_HW_DIVIDER
	help
	  Put RP2040's divider functions into SRAM.

config PICOSDK_USE_BITOPS
	bool "Use optimized bitops functions."
	select NEED_LIBC_MEM_PARTITION if SOC_SERIES_RP2040
	select RPI_PICO_USE_ROMFUNC if SOC_SERIES_RP2040
	help
	  Use optimized bitops functions. For RP2040, this option will use the ROM
	  implementation.

config PICOSDK_BITOPS_IN_RAM
	bool "Put wrapper of bitops functions into SRAM"
	default n
	depends on PICOSDK_USE_BITOPS
	depends on !(MPU && SOC_SERIES_RP2040)
	help
	  Put wrapper of bitops functions into SRAM. Incompatible with
	  (MPU && SOC_SERIES_RP2040) because initializer itself requires bitops
	  to work but in-RAM function table is still uninitialized.

config PICOSDK_USE_ROM_MEMOPS
	bool "Use ROM implementation of memcpy and memset."
	select NEED_LIBC_MEM_PARTITION
	select RPI_PICO_USE_ROMFUNC
	depends on SOC_SERIES_RP2040
	help
	  Use ROM memcpy and memset.

config PICOSDK_MEMOPS_IN_RAM
	bool "Put wrapper of memcpy and memset into SRAM"
	default n
	depends on PICOSDK_USE_ROM_MEMOPS
	help
	  Put wrapper of memcpy and memset into SRAM.

config PICOSDK_USE_MUL64
	bool "Use the optimized implementation of __aeabi_lmul."
	depends on SOC_SERIES_RP2040
	help
	  Use the optimized implementation of __aeabi_lmul.

config PICOSDK_MUL64_IN_RAM
	bool "Put __aeabi_lmul into SRAM"
	depends on PICOSDK_USE_MUL64
	help
	  Put __aeabi_lmul into SRAM.
```

## soc/raspberrypi/rpi_pico/Kconfig
```kconfig
# Raspberry Pi (RP) MCU line

# Copyright (c) 2021 Nordic Semiconductor ASA
# Copyright (c) 2021 Yonatan Schachter
# SPDX-License-Identifier: Apache-2.0

if SOC_FAMILY_RPI_PICO

rsource "*/Kconfig"

config RPI_PICO_ROM_BOOTLOADER
	bool
	default y
	depends on RETENTION_BOOT_MODE

config RPI_PICO_USE_ROMFUNC
	bool "Enable this to enable ROM function in MPU"
	depends on !NULL_POINTER_EXCEPTION_DETECTION_MPU
	help
	  Enable ROM region in MPU if needed.

endif # SOC_FAMILY_RPI_PICO
```

## soc/raspberrypi/rpi_pico/rp2040/Kconfig
```kconfig
# Raspberry Pi RP2040

# Copyright (c) 2021 Nordic Semiconductor ASA
# Copyright (c) 2021 Yonatan Schachter
# Copyright (c) 2025 Andy Lin
# SPDX-License-Identifier: Apache-2.0

config SOC_SERIES_RP2040
	select ARM
	select CPU_CORTEX_M0PLUS
	select CPU_CORTEX_M_HAS_SYSTICK
	select CPU_CORTEX_M_HAS_VTOR
	select CPU_HAS_ARM_MPU
	select HAS_RPI_PICO
	select XIP
	select HAS_SEGGER_RTT if ZEPHYR_SEGGER_MODULE
	help
	  Enable support for Raspberry Pi RP2040 MCU series

if SOC_SERIES_RP2040

config RP2_REQUIRES_SECOND_STAGE_BOOT
	bool
	default y if FLASH_LOAD_OFFSET = 0x100

config RP2_USE_SIO_DIVIDER
	bool "Enable hardware divider in SIO block and maintain the state in kernel"
	select ARM_SOC_CONTEXT_SAVE
	help
	  Enable hardware divider in SIO block and maintain the state in kernel.
	  Enable this will save and restore the context across context switch,
	  syscall and ISR.

config RP2_USERSPACE_SIO
	bool "Expose SIO block except spinlocks to userspace"
	depends on USERSPACE
	help
	  Expose some accelerators in SIO block except spinlocks to userspace. Only
	  applicable if userspace were enabled. One extra MPU entry would be used.

config RP2_USERSPACE_DIVIDER
	bool "Expose hardware divider in SIO block to userspace"
	depends on USERSPACE
	depends on RP2_USE_SIO_DIVIDER
	select RP2_USERSPACE_SIO
	help
	  Expose hardware divider in SIO block to userspace.

# Flash type used by the SoC. The board should select the one used.

config RP2_FLASH_W25Q080
	bool
	help
	  Configure RP2 to use a W25Q080 flash chip, or similar. Should be selected
	  by the board definition, not the user.

config RP2_FLASH_GENERIC_03H
	bool
	help
	  Configure RP2 to use a flash chip supporting the standard 03h command.
	  Should be selected by the board definition, not the user.

config RP2_FLASH_IS25LP080
	bool
	help
	  Configure RP2 to use a IS25LP080 flash chip, or similar. Should be selected
	  by the board definition, not the user.

config RP2_FLASH_W25X10CL
	bool
	help
	  Configure RP2 to use a W25X10CL flash chip, or similar. Should be selected
	  by the board definition, not the user.

config RP2_FLASH_AT25SF128A
	bool
	help
	  Configure RP2 to use a AT25SF128A flash chip, or similar. Should be selected
	  by the board definition, not the user.

endif
```

## soc/raspberrypi/rpi_pico/rp2350/Kconfig.defconfig
```kconfig
# Raspberry Pi RP2350 MCU line

# Copyright (c) 2024 Andrew Featherstone
# SPDX-License-Identifier: Apache-2.0

if SOC_SERIES_RP2350

config BUILD_OUTPUT_UF2_USE_FLASH_BASE
	default y if RP2_REQUIRES_IMAGE_DEFINITION_BLOCK

config BUILD_OUTPUT_UF2_USE_FLASH_OFFSET
	default y if !RP2_REQUIRES_IMAGE_DEFINITION_BLOCK

config NUM_IRQS
	default 52

if RISCV

# Only NAPOT mode is supported.
config PMP_NO_TOR
	default y

config PMP_NO_NA4
	default y

# config PMP_NO_LOCK_GLOBAL
# 	default y

# Only first 8 regions are user-programmable.
config PMP_SLOTS
	default 8

config PMP_GRANULARITY
	default 32

# Errata: RP2350-E6
config PMP_WORKAROUND_TRANSPOSED_XRW_CFG
	default y

endif

DT_CLK_SYS_PATH := $(dt_nodelabel_path,clk_sys)

config SYS_CLOCK_HW_CYCLES_PER_SEC
	default $(dt_node_int_prop_int,$(DT_CLK_SYS_PATH),clock-frequency)

config CPU_HAS_CUSTOM_FIXED_SOC_MPU_REGIONS
	default y

endif # SOC_SERIES_RP2350
```
